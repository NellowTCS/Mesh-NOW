## Firmware/sdkconfig.defaults
```kconfig
# Shared configuration for Mesh-NOW chat-app

# WiFi Configuration
CONFIG_ESP_WIFI_ENABLED=y
CONFIG_ESP_WIFI_TX_BUFFER_TYPE=1
CONFIG_ESP_WIFI_AMPDU_RX_ENABLED=y
CONFIG_ESP_WIFI_AMPDU_TX_ENABLED=y
CONFIG_ESP_WIFI_AMSDU_TX_ENABLED=y

# ESP-NOW Configuration
CONFIG_ESP_WIFI_ESPNOW_MAX_ENCRYPT_NUM=7

# Memory
CONFIG_ESP_MAIN_TASK_STACK_SIZE=8192
CONFIG_ESP_TASK_WDT_EN=y
CONFIG_ESP_TASK_WDT_TIMEOUT_S=10

# HTTP Server
CONFIG_HTTPD_MAX_REQ_HDR_LEN=1024
CONFIG_HTTPD_MAX_URI_LEN=512

# FreeRTOS
CONFIG_FREERTOS_HZ=1000

# Flash
CONFIG_ESPTOOLPY_FLASHMODE_DIO=y
CONFIG_ESPTOOLPY_FLASHSIZE_4MB=y
```

## Firmware/sdkconfig.defaults.esp32c3
```kconfig
# ESP32-C3 specific (single-core RISC-V, 400KB SRAM)

CONFIG_ESP_WIFI_STATIC_RX_BUFFER_NUM=8
CONFIG_ESP_WIFI_DYNAMIC_RX_BUFFER_NUM=24
CONFIG_ESP_WIFI_DYNAMIC_TX_BUFFER_NUM=24

CONFIG_ESP_MAIN_TASK_STACK_SIZE=7168
CONFIG_ESP_TASK_WDT_TIMEOUT_S=10

CONFIG_FREERTOS_UNICORE=y
CONFIG_ESP_MAIN_TASK_AFFINITY_NO_AFFINITY=y

CONFIG_ESPTOOLPY_FLASHFREQ_80M=y

CONFIG_ESP_CONSOLE_USB_SERIAL_JTAG=y
CONFIG_COMPILER_OPTIMIZATION_SIZE=y
```

## Firmware/sdkconfig.defaults.esp32c6
```kconfig
# ESP32-C6 specific (single-core RISC-V, 512KB SRAM)

CONFIG_ESP_WIFI_STATIC_RX_BUFFER_NUM=10
CONFIG_ESP_WIFI_DYNAMIC_RX_BUFFER_NUM=32
CONFIG_ESP_WIFI_DYNAMIC_TX_BUFFER_NUM=32

CONFIG_ESP_TASK_WDT_TIMEOUT_S=10

CONFIG_FREERTOS_UNICORE=y
CONFIG_ESP_MAIN_TASK_AFFINITY_NO_AFFINITY=y

CONFIG_ESPTOOLPY_FLASHFREQ_80M=y

CONFIG_ESP_CONSOLE_USB_SERIAL_JTAG=y
CONFIG_COMPILER_OPTIMIZATION_SIZE=y
```

## components/mesh_now/Kconfig
```kconfig
menu "Mesh-NOW"

    config MESH_NOW_BEACON_INTERVAL_MS
        int "Beacon broadcast interval (ms)"
        default 5000
        help
            How often beacons are broadcast for peer discovery.
            Range: 1000 - 60000 ms.

    config MESH_NOW_RETRANSMIT_TIMEOUT_MS
        int "Retransmit timeout (ms)"
        default 2000
        help
            How long to wait for an ACK before retransmitting a
            direct message.

    config MESH_NOW_MAX_RETRIES
        int "Maximum retransmit retries"
        default 3
        range 1 10
        help
            Maximum number of retransmit attempts before dropping
            a pending direct message.

    config MESH_NOW_MAX_PENDING_MESSAGES
        int "Maximum pending retransmit messages"
        default 16
        range 1 64
        help
            Number of slots for messages awaiting ACK confirmation.

    config MESH_NOW_MAX_SEEN_MESSAGE_IDS
        int "Seen message ID buffer size"
        default 128
        range 16 512
        help
            Ring buffer size for deduplicating recently received messages.

    config MESH_NOW_DEFAULT_ROUTE_TTL
        int "Default route TTL (hops)"
        default 3
        range 1 15
        help
            Default hop count for outgoing messages. A TTL of 3 means
            the message can be relayed through up to 2 intermediate nodes.

    config MESH_NOW_PEER_EXPIRY_SEC
        int "Peer expiry time (seconds)"
        default 30
        range 5 300
        help
            How long a peer can go without a beacon before being
            marked inactive.

    config MESH_NOW_WIFI_CHANNEL
        int "WiFi channel (1-14)"
        default 1
        range 1 14
        help
            The 802.11 channel all mesh nodes must share. ESP-NOW peers are
            registered on this channel and the WiFi STA is set to it. Every
            node in the mesh must use the same channel.

    config MESH_NOW_MAX_ROUTES
        int "Maximum route table entries"
        default 32
        range 8 128
        help
            Number of virtual-peer (route) entries. Routes reach nodes that
            are not one-hop ESP-NOW neighbors; this capacity is independent of
            MAX_PEERS.

    config MESH_NOW_ROUTE_LIFETIME_SEC
        int "Route lifetime (seconds)"
        default 30
        range 5 300
        help
            How long an unused route stays valid before it expires and must be
            re-discovered. Pinned routes never expire.

endmenu
```
